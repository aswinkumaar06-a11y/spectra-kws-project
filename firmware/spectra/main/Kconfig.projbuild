## firmware/spectra/main/Kconfig.projbuild
```kconfig
menu "Spectra KWS Audio Configuration"

    config SPECTRA_I2S_BCLK_GPIO
        int "I2S Bit Clock (BCLK) GPIO"
        default 1
        help
            GPIO pin connected to INMP441 SCK/BCLK (default 1 = D0 on XIAO ESP32-C5).

    config SPECTRA_I2S_WS_GPIO
        int "I2S Word Select (WS/LRCLK) GPIO"
        default 0
        help
            GPIO pin connected to INMP441 WS (default 0 = D1 on XIAO ESP32-C5).

    config SPECTRA_I2S_DIN_GPIO
        int "I2S Data In (DIN/SD) GPIO"
        default 23
        help
            GPIO pin connected to INMP441 SD (default 23 = D4 on XIAO ESP32-C5).
            Avoids GPIO 11 (U0TXD ROM boot conflict).

    config SPECTRA_RING_SECONDS
        int "Audio ring buffer duration in seconds"
        default 3
        range 2 10
        help
            Duration of the PSRAM audio ring buffer in seconds. Default 3s = 48,000 samples (96 KB).

    config SPECTRA_USE_WAV_INJECTOR
        bool "Enable synthetic test pattern injector instead of live I2S"
        default n
        help
            When enabled, the audio pipeline feeds synthetic deterministic PCM blocks
            for testing and verification without requiring a physical INMP441 microphone.

    config SPECTRA_MFCC_SELFTEST
        bool "Run MFCC golden self-test on boot"
        default y
        help
            Executes built-in MFCC feature extraction parity check on boot before streaming.

    config SPECTRA_MFCC_UART_TEST
        bool "Enable interactive UART MFCC parity harness mode"
        default n
        help
            Waits for host-streamed audio clips over UART to benchmark and verify MFCC parity.

endmenu

menu "Spectra KWS TFLM Inference Configuration"

    config SPECTRA_USE_ALLOPS
        bool "Use AllOpsResolver (Debug only, increases binary size)"
        default n
        help
            When enabled, TFLM uses AllOpsResolver instead of the minimal
            MicroMutableOpResolver<5> (CONV_2D, DEPTHWISE_CONV_2D, MEAN, FC, SOFTMAX).

    config SPECTRA_ARENA_KB
        int "Tensor Arena size in KB (Internal SRAM BSS)"
        default 80
        range 40 128
        help
            Size of the static tensor arena allocated in internal SRAM BSS segment.
            Default 80 KB. Recording allocator measures exact used bytes on boot.

    config SPECTRA_EQUIVALENCE_BOOT_TEST
        bool "Run 5-clip equivalence proof on boot"
        default y
        help
            Executes autonomous on-device test evaluating 5 embedded golden clips
            asserting bit-identical logits and classification accuracy.

endmenu

menu "Spectra KWS Trigger & Demo Configuration"

    choice SPECTRA_TRIGGER_DEMO_SRC
        prompt "Trigger Demo Input Source"
        default SPECTRA_TRIGGER_DEMO_SRC_LIVE
        help
            Select whether trigger consumes P(pos) from live pipeline (I2S mic)
            or from UART serial stream (feed_pstream.py).

        config SPECTRA_TRIGGER_DEMO_SRC_LIVE
            bool "Live pipeline (INMP441 I2S mic -> MFCC -> TFLM)"

        config SPECTRA_TRIGGER_DEMO_SRC_UART
            bool "UART serial stream (P(pos) fed over UART without mic)"
    endchoice

    config SPECTRA_TRIGGER_BOOT_SELFTEST
        bool "Run trigger self-test on Stream D on boot"
        default y
        help
            Executes autonomous on-device test evaluating Stream D vectors
            asserting events [2, 9] and LED transitions.

    config SPECTRA_LED_GPIO
        int "User Status LED GPIO"
        default 27
        help
            GPIO connected to user LED (27 on XIAO ESP32-C5, fallback 15).
            Active HIGH.

    config SPECTRA_TRIGGER_THRESHOLD_MILLI
        int "Trigger threshold in thousandths (e.g. 500 = 0.50)"
        default 500
        range 100 990
        help
            Threshold probability for P("Spectra") in thousandths.
            Default 500 represents 0.50.

    config SPECTRA_TRIGGER_N_FIRE
        int "Consecutive hops above threshold to fire (N_FIRE)"
        default 3
        range 1 10
        help
            Number of consecutive hop ticks (500 ms each) required to fire.

    config SPECTRA_TRIGGER_COOLDOWN
        int "Cooldown ticks after fire (COOLDOWN_TICKS)"
        default 4
        range 1 20
        help
            Number of ticks (500 ms each) to suppress triggers after firing.
            Default 4 ticks = 2.0 seconds.

endmenu

menu "Spectra Phase 5 Streaming & ASR Configuration"

    config SPECTRA_WIFI_SSID
        string "Wi-Fi SSID"
        default "myssid"
        help
            SSID of the 2.4 GHz / 5 GHz Wi-Fi network for XIAO ESP32-C5 to connect to.

    config SPECTRA_WIFI_PASSWORD
        string "Wi-Fi Password"
        default "mypassword"
        help
            WPA2/WPA3 password for Wi-Fi network.

    config SPECTRA_ASR_SERVER_IP
        string "ASR Server Host / IP"
        default "192.168.1.100"
        help
            IP address or hostname of the laptop running server/asr_server.py.

    config SPECTRA_ASR_SERVER_PORT
        int "ASR Server TCP Port"
        default 8765
        range 1024 65535
        help
            TCP port for the ASR server. Default is 8765.

    config SPECTRA_VAD_THRESHOLD_MILLI
        int "Endpoint VAD RMS Energy Threshold in thousandths (e.g. 20 = 0.020)"
        default 20
        range 1 500
        help
            RMS energy threshold normalized to [0.0, 1.0] in thousandths.
            Default 20 corresponds to 0.020. Tunable on hardware from mic telemetry.

    config SPECTRA_BOOT_BUTTON_GPIO
        int "BOOT Button Abort GPIO"
        default 28
        help
            GPIO pin for the onboard BOOT button on XIAO ESP32-C5 (active LOW).
            Pressing this button aborts active streaming.

endmenu

menu "Spectra Phase 6 Power Optimization & Calibration"

    config SPECTRA_PM_ENABLE_DFS
        bool "Enable Dynamic Frequency Scaling (DFS: 80-240 MHz)"
        default y
        help
            Enables dynamic clock scaling. Scales CPU to 240 MHz during active
            MFCC DSP, TFLM inference, and Wi-Fi streaming, dropping to 80 MHz during idle.

    config SPECTRA_PM_LIGHT_SLEEP
        bool "Enable FreeRTOS Light Sleep during idle hop windows"
        default y
        help
            Enables tickless light sleep between 500 ms inference hops,
            reducing idle current draw to ~2.5 mA.

    config SPECTRA_VAD_AUTO_CALIBRATE
        bool "Enable boot-time acoustic noise floor auto-calibration"
        default y
        help
            Samples 2.0s of background acoustic noise on boot and tunes VAD threshold.

endmenu

menu "Spectra Phase 7 Production Hardening & Resilience"

    config SPECTRA_TWDT_ENABLE
        bool "Enable Task Watchdog Timer (TWDT)"
        default y
        help
            Supervises audio capture, inference, and streaming tasks with a 3.0s timeout.

    config SPECTRA_BOOT_GUARD_ENABLE
        bool "Enable NVS Boot-Loop Guard & Safe Mode"
        default y
        help
            Detects 3 consecutive crashes and enters Safe Mode with visual alert.

    config SPECTRA_HEALTH_DIAG_LOG_INTERVAL_S
        int "Health telemetry UART log interval in seconds"
        default 30
        range 5 300
        help
            Interval for periodic system health diagnostic telemetry logging.

endmenu
```
